
#include <htc.h>
#include "lcd6610.h"

#ifndef _XTAL_FREQ
	#define _XTAL_FREQ 48000000
#endif


static const char lcd_font[][5] =
{
	{ 0x00, 0x00, 0x00, 0x00, 0x00 },  // sp
	{ 0x00, 0x00, 0x2f, 0x00, 0x00 },  // !
	{ 0x00, 0x07, 0x00, 0x07, 0x00 },  // "
	{ 0x14, 0x7f, 0x14, 0x7f, 0x14 },  // #
	{ 0x24, 0x2a, 0x7f, 0x2a, 0x12 },  // $
//	{ 0xc4, 0xc8, 0x10, 0x26, 0x46 },  // %
	{	0b00100011,						//%
		0b00010011,
		0b00001000,
		0b01100100,
		0b01100010},
   { 0x36, 0x49, 0x55, 0x22, 0x50 },  // &
   { 0x00, 0x05, 0x03, 0x00, 0x00 },  // '
   { 0x00, 0x1c, 0x22, 0x41, 0x00 },  // (
   { 0x00, 0x41, 0x22, 0x1c, 0x00 },  // )
   { 0x14, 0x08, 0x3E, 0x08, 0x14 },  // *
   { 0x08, 0x08, 0x3E, 0x08, 0x08 },  // +
   { 0x00, 0x00, 0x50, 0x30, 0x00 },  // ,
   { 0x10, 0x10, 0x10, 0x10, 0x10 },  // -
   { 0x00, 0x60, 0x60, 0x00, 0x00 },  // .
   { 0x20, 0x10, 0x08, 0x04, 0x02 },  // /
   { 0x3E, 0x51, 0x49, 0x45, 0x3E },  // 0
   { 0x00, 0x42, 0x7F, 0x40, 0x00 },  // 1
   { 0x42, 0x61, 0x51, 0x49, 0x46 },  // 2
   { 0x21, 0x41, 0x45, 0x4B, 0x31 },  // 3
   { 0x18, 0x14, 0x12, 0x7F, 0x10 },  // 4
   { 0x27, 0x45, 0x45, 0x45, 0x39 },  // 5
   { 0x3C, 0x4A, 0x49, 0x49, 0x30 },  // 6
   { 0x01, 0x71, 0x09, 0x05, 0x03 },  // 7
   { 0x36, 0x49, 0x49, 0x49, 0x36 },  // 8
   { 0x06, 0x49, 0x49, 0x29, 0x1E },  // 9
   { 0x00, 0x36, 0x36, 0x00, 0x00 },  // :
   { 0x00, 0x56, 0x36, 0x00, 0x00 },  // ;
   { 0x08, 0x14, 0x22, 0x41, 0x00 },  // <
   { 0x14, 0x14, 0x14, 0x14, 0x14 },  // =
   { 0x00, 0x41, 0x22, 0x14, 0x08 },  // >
   { 0x02, 0x01, 0x51, 0x09, 0x06 },  // ?
   { 0x32, 0x49, 0x59, 0x51, 0x3E },  // @
   { 0x7E, 0x11, 0x11, 0x11, 0x7E },  // A
   { 0x7F, 0x49, 0x49, 0x49, 0x36 },  // B
   { 0x3E, 0x41, 0x41, 0x41, 0x22 },  // C
   { 0x7F, 0x41, 0x41, 0x22, 0x1C },  // D
   { 0x7F, 0x49, 0x49, 0x49, 0x41 },  // E
   { 0x7F, 0x09, 0x09, 0x09, 0x01 },  // F
   { 0x3E, 0x41, 0x49, 0x49, 0x7A },  // G
   { 0x7F, 0x08, 0x08, 0x08, 0x7F },  // H
   { 0x00, 0x41, 0x7F, 0x41, 0x00 },  // I
   { 0x20, 0x40, 0x41, 0x3F, 0x01 },  // J
   { 0x7F, 0x08, 0x14, 0x22, 0x41 },  // K
   { 0x7F, 0x40, 0x40, 0x40, 0x40 },  // L
   { 0x7F, 0x02, 0x0C, 0x02, 0x7F },  // M
   { 0x7F, 0x04, 0x08, 0x10, 0x7F },  // N
   { 0x3E, 0x41, 0x41, 0x41, 0x3E },  // O
   { 0x7F, 0x09, 0x09, 0x09, 0x06 },  // P
   { 0x3E, 0x41, 0x51, 0x21, 0x5E },  // Q
   { 0x7F, 0x09, 0x19, 0x29, 0x46 },  // R
   { 0x46, 0x49, 0x49, 0x49, 0x31 },  // S
   { 0x01, 0x01, 0x7F, 0x01, 0x01 },  // T
   { 0x3F, 0x40, 0x40, 0x40, 0x3F },  // U
   { 0x1F, 0x20, 0x40, 0x20, 0x1F },  // V
   { 0x3F, 0x40, 0x38, 0x40, 0x3F },  // W
   { 0x63, 0x14, 0x08, 0x14, 0x63 },  // X
   { 0x07, 0x08, 0x70, 0x08, 0x07 },  // Y
   { 0x61, 0x51, 0x49, 0x45, 0x43 },  // Z
   { 0x00, 0x7F, 0x41, 0x41, 0x00 },  // [
   { 0x55, 0x2A, 0x55, 0x2A, 0x55 },  // 55
   { 0x00, 0x41, 0x41, 0x7F, 0x00 },  // ]
   { 0x04, 0x02, 0x01, 0x02, 0x04 },  // ^
   { 0x40, 0x40, 0x40, 0x40, 0x40 },  // _
   { 0x00, 0x01, 0x02, 0x04, 0x00 },  // '
   { 0x20, 0x54, 0x54, 0x54, 0x78 },  // a
   { 0x7F, 0x48, 0x44, 0x44, 0x38 },  // b
   { 0x38, 0x44, 0x44, 0x44, 0x20 },  // c
   { 0x38, 0x44, 0x44, 0x48, 0x7F },  // d
   { 0x38, 0x54, 0x54, 0x54, 0x18 },  // e
   { 0x08, 0x7E, 0x09, 0x01, 0x02 },  // f
   { 0x0C, 0x52, 0x52, 0x52, 0x3E },  // g
   { 0x7F, 0x08, 0x04, 0x04, 0x78 },  // h
   { 0x00, 0x44, 0x7D, 0x40, 0x00 },  // i
   { 0x20, 0x40, 0x44, 0x3D, 0x00 },  // j
   { 0x7F, 0x10, 0x28, 0x44, 0x00 },  // k
   { 0x00, 0x41, 0x7F, 0x40, 0x00 },  // l
   { 0x7C, 0x04, 0x18, 0x04, 0x78 },  // m
   { 0x7C, 0x08, 0x04, 0x04, 0x78 },  // n
   { 0x38, 0x44, 0x44, 0x44, 0x38 },  // o
   { 0x7C, 0x14, 0x14, 0x14, 0x08 },  // p
   { 0x08, 0x14, 0x14, 0x18, 0x7C },  // q
   { 0x7C, 0x08, 0x04, 0x04, 0x08 },  // r
   { 0x48, 0x54, 0x54, 0x54, 0x20 },  // s
   { 0x04, 0x3F, 0x44, 0x40, 0x20 },  // t
   { 0x3C, 0x40, 0x40, 0x20, 0x7C },  // u
   { 0x1C, 0x20, 0x40, 0x20, 0x1C },  // v
   { 0x3C, 0x40, 0x30, 0x40, 0x3C },  // w
   { 0x44, 0x28, 0x10, 0x28, 0x44 },  // x
   { 0x0C, 0x50, 0x50, 0x50, 0x3C },  // y
   { 0x44, 0x64, 0x54, 0x4C, 0x44 }   // z
};


void lcd_send(BYTE a, BYTE cmd)
{
	BYTE c;
	LCD_CE = 0;
	LCD_CLK = 0;
	//NOP();
	LCD_DATA = 1;
	if(cmd == LCD_TCMD)  LCD_DATA = 0;
	//else LCD_DATA = 1;
	NOP();
	LCD_CLK = 1;	
	for(c=8;c>0;c--)
	{
		LCD_CLK = 0;
		LCD_DATA = 0;
		if( a &0x80)	LCD_DATA = 1;
		NOP();
		LCD_CLK = 1;
		a = a<<1;
	}
	LCD_CE = 1;
}
void color_fill(BYTE x1, BYTE x2, BYTE y1, BYTE y2, BYTE color)
{
   unsigned long i, total;
   total = ( (unsigned long)x2-x1+1)*(y2-y1+1);
   lcd_send(CASET, LCD_TCMD);
   lcd_send(x1, LCD_TDATA);
   lcd_send(x2, LCD_TDATA);
   
   lcd_send(PASET, LCD_TCMD);
   lcd_send(y1, LCD_TDATA);
   lcd_send(y2, LCD_TDATA);
   
   lcd_send(RAMWR, LCD_TCMD);
   for(i=0; i<total; i++)   lcd_send(color, LCD_TDATA);

}
void lcd_init(void)
{
	LCD_TRIS();
	LCD_CE = 1;
	LCD_RESET = 1;
	__delay_ms(5);
	LCD_RESET = 0;
	__delay_ms(10);
	LCD_RESET = 1;
	LCD_CE = 0;

	lcd_send(SWRESET, LCD_TCMD);     // Software Reset
	lcd_send(SLEEP_OUT, LCD_TCMD);   // Sleep Out
	lcd_send(BSTRON, LCD_TCMD);      // Booster ON
	__delay_ms(10);
	lcd_send(DISPON, LCD_TCMD);      // Display ON
	lcd_send(INVOFF, LCD_TCMD);      // Mode NORMAL
	lcd_send(COLMOD, LCD_TCMD);      // interface pixel format
#if 0	//12-bit
	lcd_send(COLOR_12_BIT, LCD_TDATA);
#endif
	
#if 1	//8-bit mode
	lcd_send(COLOR_8_BIT, LCD_TDATA);   // 256 color
	lcd_send(RGBSET, LCD_TCMD);     // 
	// red
	lcd_send(0, LCD_TDATA);
	lcd_send(2, LCD_TDATA);
	lcd_send(4, LCD_TDATA);
	lcd_send(6, LCD_TDATA);
	lcd_send(8, LCD_TDATA);
	lcd_send(10, LCD_TDATA);
	lcd_send(12, LCD_TDATA);
	lcd_send(15, LCD_TDATA);
	// green
	lcd_send(0, LCD_TDATA);
	lcd_send(2, LCD_TDATA);
	lcd_send(4, LCD_TDATA);
	lcd_send(6, LCD_TDATA);
	lcd_send(8, LCD_TDATA);
	lcd_send(10, LCD_TDATA);
	lcd_send(12, LCD_TDATA);
	lcd_send(15, LCD_TDATA);
	// blue
	lcd_send(0, LCD_TDATA);
	lcd_send(4, LCD_TDATA);
	lcd_send(9, LCD_TDATA);
	lcd_send(15, LCD_TDATA);
#endif
	
	lcd_send(LCD_NOP, LCD_TCMD);
	lcd_send(MADCTL, LCD_TCMD);   // pixel write direction
	// 7:MY  6:MX  5:V  4:LAO  3:RGB 2:x  1:x  0:x
	lcd_send(0b10000000, LCD_TDATA);
	lcd_send(SETCON, LCD_TCMD);   //LCD contrast 65
	lcd_send(60, LCD_TDATA);
	lcd_clear();  // clear screen

}

void lcd_putch(BYTE c, BYTE fColor, BYTE bColor)
{
	BYTE col, row;
	if (c>'z' || c<' ') {
		return;
	}
	for(col=0; col<5; col++){
		for(row=0; row<8; row++){
			if( (lcd_font[c-' '][col]) & (0x80>>row) )
				lcd_send(fColor, LCD_TDATA);
			else
				lcd_send(bColor, LCD_TDATA);
		}
	}
	for(row=0; row<8; row++){
		lcd_send(bColor, LCD_TDATA);
	}
}

void lcd_text(const char *s, BYTE x, BYTE y, BYTE fColor, BYTE bColor)
{
	lcd_send(MADCTL, LCD_TCMD);   // pixel write direction
	// 7:MY  6:MX  5:V  4:LAO  3:RGB 2:x  1:x  0:x
	lcd_send(0b10100000, LCD_TDATA);

	lcd_send(CASET, LCD_TCMD);
	lcd_send(y, LCD_TDATA);
	lcd_send(y + 7, LCD_TDATA);
   
	lcd_send(PASET, LCD_TCMD);
	lcd_send(x, LCD_TDATA);
	lcd_send(131, LCD_TDATA);
   
	lcd_send(RAMWR, LCD_TCMD);

	while (*s) {
		lcd_putch(*s, fColor, bColor);
		++s;
	}
}

void lcd_text2( char *s, BYTE x, BYTE y, BYTE fColor, BYTE bColor)
{
	lcd_send(MADCTL, LCD_TCMD);   // pixel write direction
	// 7:MY  6:MX  5:V  4:LAO  3:RGB 2:x  1:x  0:x
	lcd_send(0b10110000, LCD_TDATA);

	lcd_send(CASET, LCD_TCMD);
	lcd_send(y, LCD_TDATA);
	lcd_send(y + 7, LCD_TDATA);
   
	lcd_send(PASET, LCD_TCMD);
	lcd_send(x, LCD_TDATA);
	lcd_send(131, LCD_TDATA);
   
	lcd_send(RAMWR, LCD_TCMD);

	while (*s) {
		lcd_putch(*s, fColor, bColor);
		++s;
	}
}